## conf/layer.conf
```bitbake
# We have a conf and classes directory, add to BBPATH
BBPATH .= ":${LAYERDIR}"

# We have recipes-* directories, add to BBFILES
BBFILES += "${LAYERDIR}/recipes-*/*/*.bb \
	${LAYERDIR}/recipes-*/*/*.bbappend"

BBFILE_COLLECTIONS += "meta-manageability"
BBFILE_PATTERN_meta-manageability = "^${LAYERDIR}/"
BBFILE_PRIORITY_meta-manageability = "6"
BB_DANGLINGAPPENDS_WARNONLY = "1"
```
